## Kconfig
```kconfig
#
# For a description of the syntax of this configuration file,
# see the file kconfig-language.txt in the NuttX tools repository.
#

config MOONCAKE_UI
	bool "A Light App Manager Library"
	default y
	---help---
		Enable support for MOONCAKE UI Manager library.
```
